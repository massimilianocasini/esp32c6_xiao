## c6_matter_thread_sd40_v1_oled/main/Kconfig.projbuild
```kconfig
menu "Matter SCD40 OLED Configuration"

    config I2C_MASTER_SDA_PIN
        int "I2C Master SDA GPIO"
        default 22
        help
            GPIO pin for I2C SDA line. Default is GPIO22 for XIAO ESP32-C6.

    config I2C_MASTER_SCL_PIN
        int "I2C Master SCL GPIO"
        default 23
        help
            GPIO pin for I2C SCL line. Default is GPIO23 for XIAO ESP32-C6.

    config I2C_MASTER_FREQ_HZ
        int "I2C Master Frequency (Hz)"
        default 100000
        help
            I2C bus frequency in Hz. SCD40 supports up to 100kHz standard mode.

    config SCD40_I2C_ADDRESS
        hex "SCD40 I2C Address"
        default 0x62
        help
            I2C address of the SCD40 CO2 sensor. Default is 0x62.

    config OLED_I2C_ADDRESS
        hex "OLED Display I2C Address"
        default 0x3C
        help
            I2C address of the SSD1306 OLED display. Default is 0x3C.

    config SENSOR_READ_INTERVAL_MS
        int "Sensor Read Interval (ms)"
        default 5000
        help
            Interval between SCD40 sensor readings in milliseconds.
            SCD40 has a measurement interval of approximately 5 seconds.

    config DISPLAY_UPDATE_INTERVAL_MS
        int "Display Update Interval (ms)"
        default 1000
        help
            Interval between OLED display updates in milliseconds.

    config RESET_BUTTON_GPIO
        int "Factory Reset Button GPIO"
        default 9
        help
            GPIO pin for the factory reset button. Default is GPIO9 (BOOT button on XIAO).

    config THREAD_STATUS_LED_GPIO
        int "Thread Status LED GPIO"
        default 15
        help
            GPIO pin for Thread connection status LED. Default is GPIO15 (built-in LED on XIAO).

endmenu
```

## c6_matter_thread_sd40_v1_oled/sdkconfig.defaults
```kconfig
# ESP32C6 XIAO Configuration - Matter over Thread with OLED
CONFIG_IDF_TARGET="esp32c6"
CONFIG_IDF_TARGET_ESP32C6=y

# Flash and Memory Configuration
CONFIG_ESPTOOLPY_FLASHSIZE_4MB=y
CONFIG_ESPTOOLPY_FLASHSIZE="4MB"
CONFIG_ESPTOOLPY_FLASHMODE_QIO=y
CONFIG_ESPTOOLPY_FLASHFREQ_80M=y

# Partition Table
CONFIG_PARTITION_TABLE_CUSTOM=y
CONFIG_PARTITION_TABLE_CUSTOM_FILENAME="partitions.csv"
CONFIG_PARTITION_TABLE_FILENAME="partitions.csv"

# Serial Configuration
CONFIG_ESPTOOLPY_BAUD=921600
CONFIG_ESPTOOLPY_MONITOR_BAUD=115200

# Matter Configuration
# Factory data provider disabled - using default provider
CONFIG_ENABLE_ESP32_FACTORY_DATA_PROVIDER=n
CONFIG_ENABLE_ESP32_DEVICE_INFO_PROVIDER=n
CONFIG_ENABLE_CHIP_SHELL=y
# Increase max dynamic endpoints to support all clusters
CONFIG_ESP_MATTER_MAX_DYNAMIC_ENDPOINT_COUNT=20

# Device Information
CONFIG_DEVICE_TYPE_ON_OFF_LIGHT=y
CONFIG_DEVICE_VENDOR_ID=0xFFF1
CONFIG_DEVICE_PRODUCT_ID=0x8001

# Thread Configuration
CONFIG_OPENTHREAD_ENABLED=y
CONFIG_OPENTHREAD_SRP_CLIENT=y
CONFIG_OPENTHREAD_DNS_CLIENT=y
CONFIG_OPENTHREAD_LOG_LEVEL_DYNAMIC=n
CONFIG_OPENTHREAD_LOG_LEVEL_NOTE=y
CONFIG_OPENTHREAD_CLI=n

# Disable WiFi (Thread only, but keep BLE for commissioning)
CONFIG_ENABLE_WIFI_STATION=n

# Bluetooth Configuration (required for Matter commissioning - using NimBLE)
CONFIG_BT_ENABLED=y
CONFIG_BT_NIMBLE_ENABLED=y
CONFIG_BT_NIMBLE_EXT_ADV=n
CONFIG_BT_NIMBLE_TRANSPORT_EVT_SIZE=70
CONFIG_USE_BLE_ONLY_FOR_COMMISSIONING=n

# Enable automatic BLE advertising for commissioning
CONFIG_CHIPOBLE_ENABLE_ADVERTISING_AUTOSTART=y

# FreeRTOS
CONFIG_FREERTOS_HZ=1000
CONFIG_FREERTOS_MAX_TASK_NAME_LEN=32

# LWIP Configuration
CONFIG_LWIP_TCPIP_TASK_STACK_SIZE=4096
CONFIG_LWIP_IPV6_AUTOCONFIG=n
CONFIG_LWIP_IPV6_NUM_ADDRESSES=8
CONFIG_LWIP_MULTICAST_PING=y
CONFIG_LWIP_NETIF_STATUS_CALLBACK=y

# MDNS platform
CONFIG_USE_MINIMAL_MDNS=n
CONFIG_ENABLE_EXTENDED_DISCOVERY=y

# mbedTLS
CONFIG_MBEDTLS_HARDWARE_SHA=y
CONFIG_MBEDTLS_HARDWARE_AES=y
CONFIG_MBEDTLS_HARDWARE_ECC=y
CONFIG_MBEDTLS_CMAC_C=y
CONFIG_MBEDTLS_SSL_PROTO_DTLS=y
CONFIG_MBEDTLS_KEY_EXCHANGE_ECJPAKE=y
CONFIG_MBEDTLS_ECJPAKE_C=y
CONFIG_MBEDTLS_HKDF_C=y

# ESP System
CONFIG_ESP_MAIN_TASK_STACK_SIZE=8192
CONFIG_ESP_SYSTEM_EVENT_TASK_STACK_SIZE=4096

# Log Configuration
CONFIG_LOG_DEFAULT_LEVEL_DEBUG=n
CONFIG_LOG_DEFAULT_LEVEL=4
CONFIG_LOG_MAXIMUM_LEVEL_DEBUG=y
CONFIG_LOG_MAXIMUM_LEVEL=4

# Console Configuration - USB Serial JTAG (native USB on ESP32C6)
CONFIG_ESP_CONSOLE_USB_SERIAL_JTAG=y
CONFIG_ESP_CONSOLE_UART_DEFAULT=n
CONFIG_ESP_CONSOLE_SECONDARY_NONE=y

# Bootloader log on USB
CONFIG_BOOTLOADER_LOG_LEVEL_INFO=y
CONFIG_BOOTLOADER_LOG_LEVEL=3

# OTA Configuration
CONFIG_ENABLE_OTA_REQUESTOR=y

# Task Watchdog
CONFIG_ESP_TASK_WDT_TIMEOUT_S=10
CONFIG_ESP_TASK_WDT_PANIC=y

# GPIO Configuration
CONFIG_GPIO_CTRL_FUNC_IN_IRAM=y

# Optimization
CONFIG_COMPILER_OPTIMIZATION_SIZE=y
CONFIG_COMPILER_OPTIMIZATION_ASSERTIONS_ENABLE=y

# I2C Configuration (for SCD40 and OLED)
CONFIG_I2C_MASTER_SDA_PIN=22
CONFIG_I2C_MASTER_SCL_PIN=23
CONFIG_I2C_MASTER_FREQ_HZ=100000
CONFIG_SCD40_I2C_ADDRESS=0x62
CONFIG_OLED_I2C_ADDRESS=0x3C
CONFIG_SENSOR_READ_INTERVAL_MS=5000
CONFIG_DISPLAY_UPDATE_INTERVAL_MS=1000
CONFIG_RESET_BUTTON_GPIO=9
CONFIG_THREAD_STATUS_LED_GPIO=15

# Button Configuration
CONFIG_BUTTON_PERIOD_TIME_MS=10
CONFIG_BUTTON_DEBOUNCE_TICKS=3
CONFIG_BUTTON_LONG_PRESS_TIME_MS=3000
```
