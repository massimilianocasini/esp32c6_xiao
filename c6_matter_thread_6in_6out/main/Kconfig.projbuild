## c6_matter_thread_6in_6out/main/Kconfig.projbuild
```kconfig
menu "Matter Light Switch Configuration"

    # DEVICE_VENDOR_ID and DEVICE_PRODUCT_ID are already defined in esp-matter
    # Use sdkconfig.defaults to set their values instead

    config DEVICE_TYPE_ON_OFF_LIGHT
        bool
        default y
        help
            Device Type On/Off Light

endmenu
```

## matter_light_switch/main/Kconfig.projbuild
```kconfig
menu "Matter Light Switch Configuration"

    config DEVICE_VENDOR_ID
        hex "Device Vendor ID"
        default 0xFFF1
        help
            Device Vendor ID for Matter

    config DEVICE_PRODUCT_ID  
        hex "Device Product ID"
        default 0x8001
        help
            Device Product ID for Matter

    config DEVICE_TYPE_ON_OFF_LIGHT
        bool
        default y
        help
            Device Type On/Off Light

endmenu
```

## matter_light_switch/sdkconfig.defaults
```kconfig
# ESP32C6 XIAO Configuration
CONFIG_IDF_TARGET="esp32c6"
CONFIG_IDF_TARGET_ESP32C6=y

# libsodium
CONFIG_LIBSODIUM_USE_MBEDTLS_SHA=y

# Flash and Memory Configuration
CONFIG_ESPTOOLPY_FLASHSIZE_4MB=y
CONFIG_ESPTOOLPY_FLASHSIZE="4MB"
CONFIG_ESPTOOLPY_FLASHMODE_QIO=y
CONFIG_ESPTOOLPY_FLASHFREQ_80M=y

# Partition Table
CONFIG_PARTITION_TABLE_CUSTOM=y
CONFIG_PARTITION_TABLE_CUSTOM_FILENAME="partitions.csv"
CONFIG_PARTITION_TABLE_FILENAME="partitions.csv"

# Serial Configuration
CONFIG_ESPTOOLPY_BAUD_921600B=y
CONFIG_ESPTOOLPY_BAUD=921600
CONFIG_ESPTOOLPY_MONITOR_BAUD_115200B=y
CONFIG_ESPTOOLPY_MONITOR_BAUD=115200

# Matter Configuration
# Factory data provider disabled - using default provider
CONFIG_ENABLE_ESP32_FACTORY_DATA_PROVIDER=n
CONFIG_ENABLE_ESP32_DEVICE_INFO_PROVIDER=n
CONFIG_ENABLE_CHIP_SHELL=y

# Device Information
CONFIG_DEVICE_TYPE_ON_OFF_LIGHT=y
CONFIG_DEVICE_VENDOR_ID=0xFFF1
CONFIG_DEVICE_PRODUCT_ID=0x8001

# Thread Configuration
CONFIG_OPENTHREAD_ENABLED=y
CONFIG_OPENTHREAD_SRP_CLIENT=y
CONFIG_OPENTHREAD_DNS_CLIENT=y
CONFIG_OPENTHREAD_LOG_LEVEL_DYNAMIC=n
CONFIG_OPENTHREAD_LOG_LEVEL_NOTE=y
CONFIG_OPENTHREAD_CLI=n

# Disable WiFi (Thread only, but keep BLE for commissioning)
CONFIG_ENABLE_WIFI_STATION=n
CONFIG_ENABLE_WIFI_AP=n

# Bluetooth Configuration (required for Matter commissioning - using NimBLE)
CONFIG_BT_ENABLED=y
CONFIG_BT_NIMBLE_ENABLED=y
CONFIG_BT_NIMBLE_EXT_ADV=n
CONFIG_BT_NIMBLE_TRANSPORT_EVT_SIZE=70
CONFIG_USE_BLE_ONLY_FOR_COMMISSIONING=n

# FreeRTOS
CONFIG_FREERTOS_HZ=1000
CONFIG_FREERTOS_MAX_TASK_NAME_LEN=32

# LWIP Configuration
CONFIG_LWIP_TCPIP_TASK_STACK_SIZE=4096
CONFIG_LWIP_IPV6_AUTOCONFIG=n
CONFIG_LWIP_IPV6_NUM_ADDRESSES=8
CONFIG_LWIP_MULTICAST_PING=y
CONFIG_LWIP_NETIF_STATUS_CALLBACK=y

# MDNS platform
CONFIG_USE_MINIMAL_MDNS=n
CONFIG_ENABLE_EXTENDED_DISCOVERY=y

# mbedTLS
CONFIG_MBEDTLS_HARDWARE_SHA=y
CONFIG_MBEDTLS_HARDWARE_AES=y
CONFIG_MBEDTLS_HARDWARE_ECC=y
CONFIG_MBEDTLS_CMAC_C=y
CONFIG_MBEDTLS_SSL_PROTO_DTLS=y
CONFIG_MBEDTLS_KEY_EXCHANGE_ECJPAKE=y
CONFIG_MBEDTLS_ECJPAKE_C=y
CONFIG_MBEDTLS_HKDF_C=y

# ESP System
CONFIG_ESP_MAIN_TASK_STACK_SIZE=8192
CONFIG_ESP_SYSTEM_EVENT_TASK_STACK_SIZE=4096

# Log Configuration
CONFIG_LOG_DEFAULT_LEVEL_DEBUG=y
CONFIG_LOG_DEFAULT_LEVEL=4
CONFIG_LOG_MAXIMUM_LEVEL_DEBUG=y
CONFIG_LOG_MAXIMUM_LEVEL=4

# Console UART
CONFIG_ESP_CONSOLE_UART_NUM=0
CONFIG_ESP_CONSOLE_UART_BAUDRATE=115200

# OTA Configuration
CONFIG_ENABLE_OTA_REQUESTOR=y

# Task Watchdog
CONFIG_ESP_TASK_WDT_TIMEOUT_S=10
CONFIG_ESP_TASK_WDT_PANIC=y

# GPIO Configuration
CONFIG_GPIO_CTRL_FUNC_IN_IRAM=y

# Optimization
CONFIG_COMPILER_OPTIMIZATION_SIZE=y
CONFIG_COMPILER_OPTIMIZATION_ASSERTIONS_ENABLE=y

# ESP32C6 Specific
CONFIG_ESP32C6_REV_MIN_0=y
CONFIG_ESP32C6_REV_MIN=0
CONFIG_ESP32C6_DEBUG_OCDAWARE=y
CONFIG_ESP32C6_BROWNOUT_DET=y
CONFIG_ESP32C6_BROWNOUT_DET_LVL_SEL_7=y
CONFIG_ESP32C6_BROWNOUT_DET_LVL=7
```
